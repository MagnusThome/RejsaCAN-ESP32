## Code Examples/RejsaCAN v6.x - ESP32-C6 - DUAL CAN self test/sdkconfig.defaults
```kconfig
CONFIG_FREERTOS_HZ=1000
CONFIG_ESP_TASK_WDT=n
CONFIG_ESPTOOLPY_FLASHSIZE_4MB=y

CONFIG_ESP_CONSOLE_USB_SERIAL_JTAG=y
CONFIG_ESP_CONSOLE_UART_NUM=-1
CONFIG_CONSOLE_UART_NUM=-1							 
CONFIG_LOG_DEFAULT_LEVEL_VERBOSE=y

# CONFIG_TWAI_ISR_IN_IRAM=y
# CONFIG_COMPILER_OPTIMIZATION_NONE=y

# silent the error check, as the error string are stored in rodata, causing RTL check failure
CONFIG_COMPILER_OPTIMIZATION_CHECKS_SILENT=y

# place non-ISR FreeRTOS functions in Flash
CONFIG_FREERTOS_PLACE_FUNCTIONS_INTO_FLASH=y

# twai driver uses assert in the ISR code path
CONFIG_COMPILER_OPTIMIZATION_ASSERTIONS_DISABLE=y
```
